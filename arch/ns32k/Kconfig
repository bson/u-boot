## arch/ns32k/Kconfig
```kconfig
menu "NS32000 architecture"
	depends on NS32K

config SYS_ARCH
	default "ns32k"

config STATIC_RELA
	default y

source "board/toy32k/Kconfig"

endmenu
```

## board/toy32k/Kconfig
```kconfig
if TARGET_TOY32K

config SYS_BOARD
	default "toy32k"

config SYS_VENDOR
	default "bson"

config SYS_CONFIG_NAME
	default "toy32k"

config TEXT_BASE
	default 0x000000

endif
```

## configs/toy32k_defconfig
```kconfig
CONFIG_NS32K=y
CONFIG_SYS_MALLOC_F_LEN=0x3000
CONFIG_ENV_SIZE=0x4000
CONFIG_ENV_SECT_SIZE=0x1000
CONFIG_SPL_TEXT_BASE=0x000000
CONFIG_SPL_STACK=0x000000
CONFIG_SPL=n

CONFIG_CMD_MEMINFO=y
CONFIG_CMD_MEMTEST=y
CONFIG_CMD_UNZIP=y
CONFIG_CMD_ADC=y
CONFIG_CMD_CLK=y
CONFIG_CMD_DFU=y
CONFIG_CMD_FUSE=y
CONFIG_CMD_GPIO=n
CONFIG_CMD_I2C=n
CONFIG_CMD_MMC=y
CONFIG_CMD_REMOTEPROC=y
CONFIG_CMD_SPI=n
CONFIG_CMD_USB=n
CONFIG_CMD_USB_MASS_STORAGE=n
CONFIG_CMD_DHCP6=y
CONFIG_CMD_TFTPPUT=y
CONFIG_SYS_DISABLE_AUTOLOAD=y
CONFIG_CMD_WGET=y
CONFIG_CMD_BOOTCOUNT=n
CONFIG_CMD_CACHE=y
CONFIG_CMD_TIME=y
CONFIG_CMD_TIMER=y
CONFIG_CMD_PMIC=n
CONFIG_CMD_REGULATOR=n
CONFIG_CMD_BTRFS=y
CONFIG_CMD_EXT4_WRITE=y
CONFIG_CMD_EEPROM=n

CONFIG_NET_RANDOM_ETHADDR=y
CONFIG_IP_DEFRAG=y
CONFIG_TFTP_TSIZE=y
CONFIG_USE_SERVERIP=y
CONFIG_SERVERIP="192.168.1.1"
CONFIG_PROT_TCP_SACK=y
CONFIG_IPV6=y
CONFIG_PHY_ANEG_TIMEOUT=20000
CONFIG_DWC_ETH_QOS=y
CONFIG_KS8851_MLL=y
CONFIG_PHY=y

CONFIG_SYS_NS16550=y
CONFIG_LZ4=y

CONFIG_DEFAULT_DEVICE_TREE="stm32mp15xx-dhcom-pdk2"

CONFIG_FAT_WRITE=y
```
